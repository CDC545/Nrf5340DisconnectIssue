## Bluetooth_Central/build/Bluetooth_Central/Kconfig/Kconfig.shield
```kconfig
osource "C:/NRFTestCode/Bluetooth_Central/boards/shields/*/Kconfig.shield"
osource "C:/ncs/v2.9.0/nrf/boards/shields/*/Kconfig.shield"
```

## Bluetooth_Central/build/Kconfig/Kconfig.shield.defconfig
```kconfig
osource "C:/NRFTestCode/Bluetooth_Central/boards/shields/*/Kconfig.defconfig"
osource "C:/ncs/v2.9.0/nrf/boards/shields/*/Kconfig.defconfig"
```

## Bluetooth_Central/build_1/Bluetooth_Central/Kconfig/Kconfig.shield
```kconfig
osource "C:/NRFTestCode/Bluetooth_Central/boards/shields/*/Kconfig.shield"
osource "C:/ncs/v2.8.0/nrf/boards/shields/*/Kconfig.shield"
```

## Bluetooth_Central/build_1/ipc_radio/Kconfig/Kconfig.shield.defconfig
```kconfig
osource "C:/NRFTestCode/Bluetooth_Central/boards/shields/*/Kconfig.defconfig"
osource "C:/ncs/v2.8.0/nrf/boards/shields/*/Kconfig.defconfig"
```

## Bluetooth_Central/build_1/ipc_radio/Kconfig/boards/Kconfig.sysbuild
```kconfig
# Load Sysbuild board Kconfig descriptions.
osource "C:/ncs/v2.8.0/zephyr/boards/nordic/nrf5340dk/Kconfig.sysbuild"
```

## Bluetooth_peripheral/build_1/ipc_radio/Kconfig/Kconfig.shield.defconfig
```kconfig
osource "C:/NRFTestCode/Bluetooth_peripheral/boards/shields/*/Kconfig.defconfig"
osource "C:/ncs/v2.8.0/nrf/boards/shields/*/Kconfig.defconfig"
```

## Bluetooth_peripheral/build_2/Kconfig/Kconfig.shield
```kconfig
osource "C:/NRFTestCode/Bluetooth_peripheral/boards/shields/*/Kconfig.shield"
osource "C:/ncs/v2.9.0/nrf/boards/shields/*/Kconfig.shield"
```

## Bluetooth_peripheral/build_2/Kconfig/Kconfig.shield.defconfig
```kconfig
osource "C:/NRFTestCode/Bluetooth_peripheral/boards/shields/*/Kconfig.defconfig"
osource "C:/ncs/v2.9.0/nrf/boards/shields/*/Kconfig.defconfig"
```
